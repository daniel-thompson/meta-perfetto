## conf/layer.conf
```bitbake
# We have a conf and classes directory, add to BBPATH
BBPATH .= ":${LAYERDIR}"

# We have recipes-* directories, add to BBFILES
BBFILES += "${LAYERDIR}/recipes-*/*/*.bb \
            ${LAYERDIR}/recipes-*/*/*.bbappend"

BBFILE_COLLECTIONS += "meta-perfetto"
BBFILE_PATTERN_meta-perfetto = "^${LAYERDIR}/"
BBFILE_PRIORITY_meta-perfetto = "6"

LAYERDEPENDS_meta-perfetto = "core"
LAYERSERIES_COMPAT_meta-perfetto = "dunfell"
```
